## faces-arcade/main/Kconfig.projbuild
```kconfig
menu "FACES ARCADE"
    config FACES_DESCRIPTION_HOST
        string "Photo description server address"
        default "100.80.152.112"
    config FACES_DESCRIPTION_PORT
        int "Photo description server port"
        range 0 65535
        default 8193
    config FACES_DESCRIPTION_MODEL
        string "Photo description model"
        default "vision"
endmenu
```

## faces-arcade/sdkconfig.defaults.esp32s3
```kconfig
CONFIG_ESPTOOLPY_FLASHMODE_QIO=y
CONFIG_ESPTOOLPY_FLASHFREQ_80M=y
CONFIG_SPIRAM_MODE_QUAD=y
CONFIG_SPIRAM_SPEED_80M=y
CONFIG_ESP_CONSOLE_USB_SERIAL_JTAG=y
CONFIG_ESP_SYSTEM_EVENT_TASK_STACK_SIZE=4608
# CONFIG_ML_ENABLE_CONFIG_HTTPD is not set
CONFIG_MBEDTLS_CHACHA20_C=y
CONFIG_MBEDTLS_POLY1305_C=y
CONFIG_MBEDTLS_CHACHAPOLY_C=y
CONFIG_BT_ENABLED=y
CONFIG_BT_NIMBLE_ENABLED=y
CONFIG_BT_BLUEDROID_ENABLED=n
CONFIG_BT_NIMBLE_HOST_TASK_STACK_SIZE=8192
CONFIG_ESP_COEX_SW_COEXIST_ENABLE=y
```
